## Config.in
```kconfig
source "$BR2_EXTERNAL_CERES_PATH/package/ceres-init-generic/Config.in"

source "$BR2_EXTERNAL_CERES_PATH/package/ceres-cfg/Config.in"
source "$BR2_EXTERNAL_CERES_PATH/package/ceres-templates-interfaces/Config.in"

source "$BR2_EXTERNAL_CERES_PATH/package/bird4/Config.in"
source "$BR2_EXTERNAL_CERES_PATH/package/bird6/Config.in"
```

## configs/buildroot_defconfig
```kconfig
BR2_TOOLCHAIN_BUILDROOT_MUSL=y
BR2_TARGET_GENERIC_HOSTNAME="ceres-base"
BR2_TARGET_GENERIC_ISSUE="Welcome to ceres-base"
BR2_TARGET_GENERIC_ROOT_PASSWD="root"
BR2_TARGET_TZ_INFO=y
BR2_LINUX_KERNEL=y
BR2_LINUX_KERNEL_USE_CUSTOM_CONFIG=y
BR2_LINUX_KERNEL_CUSTOM_CONFIG_FILE="$(BR2_EXTERNAL)/configs/linux_defconfig"
BR2_LINUX_KERNEL_INSTALL_TARGET=y
BR2_ROOTFS_OVERLAY="$(BR2_EXTERNAL)/overlay"
BR2_PACKAGE_PYTHON3_SSL=y
BR2_PACKAGE_DNSMASQ=y
BR2_PACKAGE_IPTABLES=y
BR2_PACKAGE_IPUTILS=y
BR2_PACKAGE_OPENSSH=y
BR2_PACKAGE_TCPDUMP=y
BR2_PACKAGE_OPKG=y
BR2_PACKAGE_SUDO=y
BR2_PACKAGE_NANO=y
BR2_TARGET_ROOTFS_EXT2=y
BR2_TARGET_ROOTFS_EXT2_4=y
BR2_TARGET_ROOTFS_SQUASHFS=y
# BR2_TARGET_ROOTFS_TAR is not set
BR2_TARGET_SYSLINUX=y
BR2_PACKAGE_CERES_TEMPLATES_INTERFACES=y
BR2_PACKAGE_BIRD4=y
BR2_PACKAGE_BIRD6=y
```

## configs/ceres_generic_defconfig
```kconfig
BR2_TOOLCHAIN_BUILDROOT_MUSL=y
BR2_TARGET_GENERIC_HOSTNAME="ceres-base"
BR2_TARGET_GENERIC_ISSUE="Welcome to ceres-base"
BR2_TARGET_GENERIC_ROOT_PASSWD="root"
BR2_TARGET_TZ_INFO=y
BR2_ROOTFS_OVERLAY="$(BR2_EXTERNAL)/overlay"
BR2_ROOTFS_POST_IMAGE_SCRIPT="$(BR2_EXTERNAL)/scripts/create-filesystem"
BR2_ROOTFS_POST_SCRIPT_ARGS="$(BR2_EXTERNAL)"
BR2_LINUX_KERNEL=y
BR2_LINUX_KERNEL_USE_ARCH_DEFAULT_CONFIG=y
BR2_LINUX_KERNEL_CONFIG_FRAGMENT_FILES="$(BR2_EXTERNAL)/fragments/kernel.config.fragment"
BR2_LINUX_KERNEL_INSTALL_TARGET=y
BR2_ROOTFS_DEVICE_CREATION_DYNAMIC_MDEV=y
BR2_PACKAGE_BUSYBOX=y
BR2_PACKAGE_SKELETON=y
BR2_PACKAGE_BUSYBOX_CONFIG_FRAGMENT_FILES="$(BR2_EXTERNAL)/fragments/busybox.config.fragment"
BR2_PACKAGE_BUSYBOX_SHOW_OTHERS=y
# BR2_PACKAGE_PYTHON3_UNICODEDATA is not set
BR2_PACKAGE_DNSMASQ=y
BR2_PACKAGE_IPTABLES=y
BR2_PACKAGE_IPUTILS=y
BR2_PACKAGE_OPENSSH=y
BR2_PACKAGE_TCPDUMP=y
BR2_PACKAGE_OPKG=y
BR2_PACKAGE_SUDO=y
BR2_PACKAGE_NANO=y
BR2_TARGET_ROOTFS_EXT2=y
BR2_TARGET_ROOTFS_EXT2_4=y
BR2_TARGET_ROOTFS_SQUASHFS=y
# BR2_TARGET_ROOTFS_TAR is not set
BR2_TARGET_SYSLINUX=y
# BR2_PACKAGE_CERES_INIT_GENERIC is not set
# BR2_PACKAGE_CERES_TEMPLATES_INTERFACES is not set
# BR2_PACKAGE_BIRD4 is not set
# BR2_PACKAGE_BIRD6 is not set
BR2_PACKAGE_UTIL_LINUX_NSENTER=y
BR2_PACKAGE_UTIL_LINUX_UNSHARE=y
```

## package/bird4/Config.in
```kconfig
config BR2_PACKAGE_BIRD4
	bool "bird4"
	help
	  BIRD Internet Routing Daemon (IPv4).

	  http://bird.network.cz/
```

## package/bird6/Config.in
```kconfig
config BR2_PACKAGE_BIRD6
	bool "bird6"
	help
	  BIRD Internet Routing Daemon (IPv6).

	  http://bird.network.cz/
```

## package/ceres-cfg/Config.in
```kconfig
config BR2_PACKAGE_CERES_CFG
	bool "ceres-cfg"
	select BR2_PACKAGE_CERES_ENV_OVERLAY
	select BR2_PACKAGE_PYTHON3
	select BR2_PACKAGE_PYTHON_FLASK
	select BR2_PACKAGE_PYTHON_REQUESTS
	help
	  ceres-cfg is the Ceres configuration system.

	  https://ceres.github.io/
```

## package/ceres-env-overlay/Config.in
```kconfig
config BR2_PACKAGE_CERES_ENV_OVERLAY
	bool "ceres-env-overlay"
	help
	  ceres-env-overlay contains files that are overlayed
	  onto the ceres-base filesystem during build.

	  https://ceres.github.io/
```

## package/ceres-init-generic/Config.in
```kconfig
config BR2_PACKAGE_CERES_INIT_GENERIC
	bool "ceres-init-generic"
	help
	  ceres-init-generic is a lightweight initramfs.

	  https://ceres.github.io/
```

## package/ceres-templates-interfaces/Config.in
```kconfig
config BR2_PACKAGE_CERES_TEMPLATES_INTERFACES
	bool "ceres-templates-interfaces"
	select BR2_PACKAGE_CERES_CFG
	select BR2_PACKAGE_IPROUTE2
	select BR2_PACKAGE_NET_TOOLS
	select BR2_PACKAGE_BRIDGE_UTILS
	help
	  ceres-templates-interfaces contain core templates
	  for manipulating ethernet/loopback/VRF interfaces.

	  https://ceres.github.io/
```
